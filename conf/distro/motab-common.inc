## recipes-bsp/u-boot/u-boot-ti-staging/motab_defconfig
```kconfig
#||******************************************************* Arch select
CONFIG_ARM=y
#||********************************************************** ARM arch
CONFIG_ARCH_CPU_INIT=y
CONFIG_ARCH_OMAP2PLUS=y
CONFIG_AM33XX=y
CONFIG_SYS_MPUCLK=1000
CONFIG_TARGET_BRANA_MOTAB=y

#||***************************************************** General setup
CONFIG_NR_DRAM_BANKS=1
CONFIG_HAS_CUSTOM_SYS_INIT_SP_ADDR=y
CONFIG_CUSTOM_SYS_INIT_SP_ADDR=0x4030ff00
##CONFIG_SYS_MALLOC_F_LEN=0x3000
# CONFIG_SYS_MALLOC_CLEAR_ON_INIT is not set
#||*************************************************************** API
#||****************************************************** Boot options
#||                                                        Boot images
# CONFIG_FIT is not set
CONFIG_OF_BOARD_SETUP=y
#||                                                   Autoboot options
CONFIG_BOOTDELAY=-2

#||*********************************************************** Console
CONFIG_LOGLEVEL=7
# CONFIG_CONSOLE_FLUSH_SUPPORT is not set
# CONFIG_CONSOLE_MUX is not set
#||*********************************************************** Logging
##CONFIG_LOG=y
CONFIG_LOG_MAX_LEVEL=7
CONFIG_LOG_DEFAULT_LEVEL=7
##CONFIG_SPL_LOG=y
CONFIG_SPL_LOG_MAX_LEVEL=7
CONFIG_LOG_ERROR_RETURN=y

#||****************************************************** Init options
#||************************************************** Security support
#||**************************************************** Update support
#||********************************************************* Blob list
#||********************************************************* SPL / TPL
CONFIG_SPL=y
##CONFIG_SPL_SHOW_ERRORS=y
# CONFIG_SPL_RAW_IMAGE_SUPPORT is not set
CONFIG_SPL_SYS_MALLOC_SIMPLE=y
CONFIG_SYS_SPL_MALLOC=y
CONFIG_SYS_SPL_MALLOC_SIZE=0x800000
# CONFIG_SPL_BANNER_PRINT is not set
# CONFIG_SYS_MMCSD_RAW_MODE_U_BOOT_USE_SECTOR is not set
# CONFIG_SPL_CRC32 is not set

##CONFIG_SPL_GPIO=y
CONFIG_SPL_I2C=y
CONFIG_SPL_LIBCOMMON_SUPPORT=y
CONFIG_SPL_LIBGENERIC_SUPPORT=y

# CONFIG_SPL_NAND_SUPPORT is not set

CONFIG_SPL_DM_SPI=y
CONFIG_SPL_DM_SPI_FLASH=y

CONFIG_SPL_POWER=y

CONFIG_SPL_SERIAL=y

CONFIG_SPL_SPI=y
CONFIG_SPL_SPI_FLASH_SUPPORT=y
CONFIG_SPL_SPI_FLASH_TINY=y
CONFIG_SPL_SPI_LOAD=y
CONFIG_SYS_SPI_U_BOOT_OFFS=0x20000

# CONFIG_SPL_AM33XX_ENABLE_RTC32K_OSC is not set
#||******************************************** Command line interface
CONFIG_SYS_PROMPT="U-Boot#"
# CONFIG_SYS_XTRACE is not set
# CONFIG_CMDLINE_EDITING is not set
# CONFIG_AUTO_COMPLETE is not set
# CONFIG_SYS_LONGHELP is not set

# CONFIG_CMD_BDI is not set
# CONFIG_CMD_CONSOLE is not set

# CONFIG_CMD_BOOTD is not set
CONFIG_CMD_BOOTZ=y
# CONFIG_BOOTM_NETBSD is not set
# CONFIG_BOOTM_PLAN9 is not set
# CONFIG_BOOTM_RTEMS is not set
# CONFIG_BOOTM_VXWORKS is not set
# CONFIG_CMD_ELF is not set
# CONFIG_CMD_FDT is not set
# CONFIG_CMD_GO is not set
# CONFIG_CMD_RUN is not set
# CONFIG_CMD_IMI is not set
# CONFIG_CMD_XIMG is not set
# CONFIG_CMD_EXPORTENV is not set
# CONFIG_CMD_IMPORTENV is not set
# CONFIG_CMD_SAVEENV is not set
# CONFIG_CMD_ENV_EXISTS is not set
# CONFIG_CMD_CRC32 is not set
# CONFIG_CMD_MEMORY is not set
# CONFIG_CMD_FLASH is not set
# CONFIG_CMD_LOADB is not set
# CONFIG_CMD_LOADS is not set
CONFIG_CMD_MTD=y
CONFIG_CMD_NAND=y
# CONFIG_CMD_ITEST is not set
# CONFIG_CMD_SOURCE is not set
# CONFIG_CMD_SETEXPR is not set
# CONFIG_CMD_NET is not set
# CONFIG_CMD_CLS is not set
# CONFIG_CMD_SLEEP is not set
# CONFIG_CMD_VIDCONSOLE is not set

CONFIG_CMD_UBI=y
#||*************************************************** Partition Types
#||*********************************************** Device Tree Control
CONFIG_OF_CONTROL=y
##CONFIG_SPL_OF_CONTROL=y
##CONFIG_DEFAULT_DEVICE_TREE="motab"
# CONFIG_OF_TAG_MIGRATE is not set
CONFIG_OF_SPL_REMOVE_PROPS=""
##CONFIG_SPL_OF_PLATDATA=y

#||******************************************************* Environment
CONFIG_SYS_RELOC_GD_ENV_ADDR=y
#||************************************************ Networking support
# CONFIG_NET is not set
#||**************************************************** Device Drivers
CONFIG_DM=y
CONFIG_SPL_DM=y
### CONFIG_DM_WARN is not set
CONFIG_SPL_DM_WARN=y
##CONFIG_DM_DEBUG=y
# CONFIG_DM_DEVICE_REMOVE is not set
CONFIG_SPL_DM_SEQ_ALIAS=y
CONFIG_REGMAP=y
##CONFIG_SPL_REGMAP=y
CONFIG_SPL_OF_TRANSLATE=y

#||                                                        Bus devices
CONFIG_SPL_TI_SYSC=y
#||                                                              Clock
CONFIG_CLK=y
##CONFIG_SPL_CLK=y
##CONFIG_SPL_CLK_CCF=y
CONFIG_CLK_CCF=y

CONFIG_CLK_TI_AM3_DPLL=y
CONFIG_CLK_TI_CTRL=y
CONFIG_CLK_TI_DIVIDER=y
CONFIG_CLK_TI_GATE=y
CONFIG_CLK_TI_MUX=y 

#||                                                        DFU Support
#||                                                       GPIO Support
CONFIG_DM_GPIO=y
#||                                                        I2C support
CONFIG_DM_I2C=y
#||                                             Enable input subsystem
# CONFIG_INPUT is not set
#||                                        MMC Host controller Support
# CONFIG_MMC is not set
#||                                                        MTD Support
CONFIG_MTD=y
CONFIG_DM_MTD=y
CONFIG_MTD_RAW_NAND=y
CONFIG_SYS_NAND_ONFI_DETECTION=y
CONFIG_SYS_NAND_PAGE_SIZE=0x800
CONFIG_SYS_NAND_OOBSIZE=0x40

CONFIG_DM_SPI_FLASH=y
CONFIG_SPI_FLASH=y
CONFIG_SF_DEFAULT_SPEED=48000000
CONFIG_SPI_FLASH_ISSI=y

#||                    Ethernet PHY (physical media interface) support
#||                                             Network device support
#||                                                    Pin controllers
#||                                                              Power
CONFIG_DM_PMIC=y
# CONFIG_SPL_DM_PMIC is not set
CONFIG_PMIC_TPS65217=y
#||                                                     Serial drivers
CONFIG_BAUDRATE=115200
### CONFIG_REQUIRE_SERIAL_CONSOLE is not set
### CONFIG_SPL_SERIAL_PRESENT is not set
CONFIG_DM_SERIAL=y

CONFIG_DEBUG_UART=y
CONFIG_DEBUG_UART_OMAP=y
CONFIG_DEBUG_UART_BASE=0x44e09000
CONFIG_DEBUG_UART_CLOCK=48000000
CONFIG_DEBUG_UART_SHIFT=2
CONFIG_DEBUG_UART_BOARD_INIT=y
CONFIG_DEBUG_UART_ANNOUNCE=y

#||                                                        SPI Support
CONFIG_SPI=y
CONFIG_DM_SPI=y
CONFIG_OMAP3_SPI=y
#||                                                      Timer Support
#||                                                        USB support
#||                                                   Graphics support
CONFIG_VIDEO=y
CONFIG_BACKLIGHT_GPIO=y
### CONFIG_CONSOLE_NORMAL is not set
CONFIG_SYS_WHITE_ON_BLACK=y
CONFIG_PANEL=y
# CONFIG_SIMPLE_PANEL is not set
CONFIG_AM335X_LCD=y

##CONFIG_SPL_VIDEO=y
### CONFIG_SPL_CONSOLE_NORMAL is not set
# CONFIG_SPL_SIMPLE_PANEL is not set


#||****************************************************** File systems
#||************************************************** Library routines
# CONFIG_SPL_USE_TINY_PRINTF is not set
# CONFIG_REGEX is not set
# CONFIG_GZIP is not set
# CONFIG_ZLIB is not set
# CONFIG_OF_LIBFDT_OVERLAY is not set
##CONFIG_SPL_OF_LIBFDT=y
```
