## conf/distro/motab-common.inc
```bitbake
DISTRO_VERSION = "2024.04"

INIT_MANAGER = "systemd"
##INIT_MANAGER = "sysvinit"
##INIT_MANAGER = "mdev-busybox"

##PREFERRED_PROVIDER_udev = ""
##PACKAGECONFIG:remove:pn-ti-sgx-ddk-um = "udev"

OPKG_ARGS:remove = "--prefer-arch-to-version"

DISTRO_FEATURES_DEFAULT:remove = " \
 acl \
 alsa \
 argp \
 bluetooth \
 debuginfod \
 ext2 \
 largefile \
 pcmcia \
 usbgadget \
 usbhost \
 wifi \
 xattr \
 nfs \
 zeroconf \
 pci \
 3g \
 nfc \
 x11 \
 vfat \
 seccomp \
"

DISTRO_FEATURES_BACKFILL_CONSIDERED = " \
 pulseaudio \
"
DISTRO_FEATURES:append = " pam wayland opengl "
##DISTRO_FEATURES:append = " wayland opengl "

DEFAULT_TIMEZONE = "Europe/Istanbul"

USE_VT = "0"

PACKAGECONFIG:remove:pn-gdb = "python"
PACKAGECONFIG:remove:pn-opkg-utils = "python"

PACKAGECONFIG:remove:pn-systemd = " \
  gshadow \
  hostnamed \
  idn \
  ima \
  kmod \
  localed \
  machined \
  myhostname \
  networkd \
  nss \
  nss-mymachines \
  nss-resolve \
  quotacheck \
  randomseed \
  resolved \
  set-time-epoch \
  sysusers \
  sysvinit \
  timedated \
  timesyncd \
  userdb \
  utmp \
  vconsole \
  wheel-group \
  backlight \
  binfmt \
  zstd \
  hibernate \
  "
#
#  logind \
#

SYSTEMD_DEFAULT_TARGET = "graphical.target"


##ENABLE_BINARY_LOCALE_GENERATION = "0"
##GLIBC_GENERATE_LOCALES = "en_US.UTF-8 tr_TR.UTF-8"
##IMAGE_LINGUAS = "en-us tr-tr"
##IMAGE_LINGUAS:remove = " en-us "

PACKAGECONFIG:remove:pn-libdrm = " \
 intel \
 radeon \
 amdgpu \
 nouveau \
 vmwgfx \
 freedreno \
 vc4 \
 etnaviv \
"
##hostname:pn-base-files = "the-hostname"

SIMPLECLIENTS = "egl"

PACKAGECONFIG:remove:pn-weston = " \
 shell-ivi \
 shell-kiosk \
 image-jpeg \
"
##
## wayland \
## shell-desktop \
##
##

INHERIT_DISTRO:remove = "create-spdx"
```

## conf/distro/motab-dvl.conf
```bitbake
DISTRO_NAME = "MOTAB Distro - development version"

include motab-common.inc

UBOOT_MACHINE:motab-dvl = "motab-dvl_config"
##UBOOT_MACHINE:motab-dvl = "am335x_evm_config"

DEPLOY_DIR_IMAGE:motab-dvl = "/srv/tftp/motab/dvl"
```

## conf/distro/motab.conf
```bitbake
# Name and version of the distribution
DISTRO_NAME = "MOTAB Distro - Release"

include motab-common.inc


UBOOT_MACHINE:motab = "motab_config"
DEPLOY_DIR_IMAGE:motab = "${TOPDIR}/deploy-motab"
```

## conf/distro/motabdistro.conf
```bitbake
# Name and version of the distribution
DISTRO_NAME = "MOTAB Distro"
DISTRO_VERSION = "2023.07"
###--------------------------------------------------------------------------------------
DISTRO_FEED_URI ?= "http://lcpd.itg.ti.com"
BUILD_VARIANT = "${@['prod','rt','systest'][int(d.getVar('ARAGO_RT_ENABLE'))+int(d.getVar('ARAGO_SYSTEST_ENABLE'))*2]}"
TISDK_VERSION ?= "live"
FEEDURIPREFIX ?= "packages/${DISTRO}-dunfell/${TISDK_VERSION}/${BUILD_VARIANT}/"

OPKG_ARGS_remove = "--prefer-arch-to-version"

TI_MIRROR = "http://software-dl.ti.com/processor-sdk-mirror/sources/"
MIRRORS += " \
ftp://.*/.*       http://arago-project.org/files/sources/ \n \
https?$://.*/.*   http://arago-project.org/files/sources/ \n \
bzr://.*/.*      ${TI_MIRROR} \n \
cvs://.*/.*      ${TI_MIRROR} \n \
git://.*/.*      ${TI_MIRROR} \n \
gitsm://.*/.*    ${TI_MIRROR} \n \
hg://.*/.*       ${TI_MIRROR} \n \
osc://.*/.*      ${TI_MIRROR} \n \
p4://.*/.*       ${TI_MIRROR} \n \
npm://.*/.*      ${TI_MIRROR} \n \
ftp://.*/.*      ${TI_MIRROR} \n \
https?$://.*/.*  ${TI_MIRROR} \n \
svn://.*/.*      ${TI_MIRROR} \n \
"

# SDK paths and names
SDK_NAME_PREFIX = "arago"
SDK_VERSION = "${DISTRO_VERSION}"
SDK_VENDOR = "-${SDK_NAME_PREFIX}"
SDK_NAME = "${SDK_NAME_PREFIX}-${SDK_VERSION}"
SDKPATH_REAL = "/usr/local/${SDK_NAME_PREFIX}-${SDK_VERSION}"
SDKPATH = "${@"/tmp/"+"x"*96+"/"+"y"*96}"

###IMAGE_CLASSES += "image_types_md5"
###IMAGE_FSTYPES += "tar.xz.md5"

###TCMODEAPPEND ?= "-${TCMODE}"
###TMPDIR .= "${TCMODEAPPEND}"

LIBC_DEPENDENCIES_remove = "glibc-gconv-cp1252 glibc-gconv-ibm850 glibc-gconv-iso8859-1 glibc-gconv-iso8859-15 glibc-localedata-i18n"


DISTRO_FEATURES_remove = " \
 alsa \
 argp \
 bluetooth \
 debuginfod \
 ext2 \
 largefile \
 pcmcia \
 usbgadget \
 usbhost \
 wifi \
 nfs \
 zeroconf \
 pci \
 3g \
 nfc \
 x11 \
 vfat \
 seccomp \
"

DISTRO_FEATURES_BACKFILL_CONSIDERED = " \
 pulseaudio \
 gobject-introspection-data \
"

DISTRO_FEATURES_append = " \
  opengl \
  usrmerge \
"

##INIT_MANAGER = "mdev-busybox"
INIT_MANAGER = "sysvinit"

##DISTRO_FEATURES_BACKFILL_CONSIDERED_append = " systemd"
VIRTUAL-RUNTIME_dev_manager = "udev"
##VIRTUAL-RUNTIME_init_manager = "busybox"
##VIRTUAL-RUNTIME_init_manager = "sysvinit"
##VIRTUAL-RUNTIME_initscripts = "initscripts"
##VIRTUAL-RUNTIME_keymaps = "keymaps"
##VIRTUAL-RUNTIME_login_manager = "busybox"



# Normally target distro features will not be applied to native builds:
# Native distro features on this list will use the target feature value
###DISTRO_FEATURES_FILTER_NATIVE_append = " opencl opencv openmp"
###DISTRO_FEATURES_FILTER_NATIVESDK_append = " opencl opencv openmp"

# Set global runtime providers for major components
###ARAGO_SYSVINIT ?= "0"
###VIRTUAL-RUNTIME_dev_manager = "${@["udev", "systemd"][bool(d.getVar("ARAGO_SYSVINIT"))]}"
###VIRTUAL-RUNTIME_init_manager = "${@["sysvinit", "systemd"][bool(d.getVar("ARAGO_SYSVINIT"))]}"
###VIRTUAL-RUNTIME_initscripts = "${@["initscripts", "systemd-compat-units"][bool(d.getVar("ARAGO_SYSVINIT"))]}"
###VIRTUAL-RUNTIME_initramfs = "${@["sysvinit-initramfs", "systemd-initramfs"][bool(d.getVar("ARAGO_SYSVINIT"))]}"
###VIRTUAL-RUNTIME_login_manager = "busybox shadow"

###DISTRO_FEATURES_append = "${@[""," systemd"][bool(d.getVar("ARAGO_SYSVINIT"))]}"

# Set preferred Qt version
###QT_PROVIDER ?= "qt5"

# Distro-specific package configuration
###PACKAGECONFIG_append_pn-systemd = " coredump"

# Configure Qt5 flags (GLES is still required for qtdeclarative and qtwebkit)
###PACKAGECONFIG_GL_pn-qtbase = "gles2 linuxfb"
###PACKAGECONFIG_DISTRO_pn-qtbase = "icu examples accessibility gif gbm kms libinput"
###PACKAGECONFIG_FONTS_pn-qtbase = "fontconfig"

# Add gstreamer in package configuration to enable video
###PACKAGECONFIG_append_pn-qtmultimedia = " gstreamer"

# Add examples in Qt5 package configurations
###PACKAGECONFIG_append_pn-qtcharts = " examples"
#PACKAGECONFIG_append_pn-qtdeclarative = " examples"
###PACKAGECONFIG_append_pn-qtlocation = " examples"
###PACKAGECONFIG_append_pn-qtmultimedia = " examples"
###PACKAGECONFIG_append_pn-qtscript = " examples"
###PACKAGECONFIG_append_pn-qtserialport = " examples"
###PACKAGECONFIG_append_pn-qtsvg = " examples"
###PACKAGECONFIG_append_pn-qtwayland = " examples"
###PACKAGECONFIG_append_pn-qtwebengine = " examples"

# Prefer OpenSSL over GnuTLS for curl due to TSU exemptions
PACKAGECONFIG_pn-curl = "${@bb.utils.contains("DISTRO_FEATURES", "ipv6", "ipv6", "", d)} ssl zlib"

PACKAGECONFIG_pn-glmark2 = "drm-gles2 wayland-gles2"

# Enable encryption support in open62541
PACKAGECONFIG_append_pn-open62541 = " encrypt"

# Enable netperf intervals/pacing and histogram
PACKAGECONFIG_append_pn-netperf = " intervals histogram"

# Use OpenGL ES2 for SDL2
PACKAGECONFIG_GL_pn-libsdl2 = "gles2"

# Add KMS/DRM backend support
PACKAGECONFIG_append_pn-libsdl2 = " kmsdrm"

# Enable cryptodev/devcrypto engine in OpenSSL 1.1
PACKAGECONFIG_append_pn-openssl = " cryptodev-linux"

# Disable pulseaudio routing in alsa by default
PACKAGECONFIG_remove_pn-alsa-plugins = "pulseaudio"
RDEPENDS_pulseaudio-server_remove = "alsa-plugins-pulseaudio-conf"

# Enable UI and scripting for perf
PERF_FEATURES_ENABLE ?= "perf-scripting perf-tui"

# Do not warn on meta-gnome w/o x11
SKIP_META_GNOME_SANITY_CHECK = "1"

ARAGO_KERNEL_SUFFIX ?= ""

# Set real-time kernel suffix
ARAGO_RT_ENABLE ?= "0"
ARAGO_KERNEL_SUFFIX_append = "${@oe.utils.conditional("ARAGO_RT_ENABLE", "1", "-rt", "", d)}"

# Set systest kernel suffix
ARAGO_SYSTEST_ENABLE ?= "0"
ARAGO_KERNEL_SUFFIX_append = "${@oe.utils.conditional("ARAGO_SYSTEST_ENABLE", "1", "-systest", "", d)}"
IMAGE_FSTYPES_remove = "${@['','ubi ubifs'][d.getVar('ARAGO_SYSTEST_ENABLE') == '1']}"


LINUXLIBCVERSION = "5.10%"

PREFERRED_PROVIDER_gcc-cross-canadian-${TRANSLATED_TARGET_ARCH} ?= "gcc-cross-canadian-${TRANSLATED_TARGET_ARCH}"
PREFERRED_PROVIDER_binutils-cross-canadian-${TRANSLATED_TARGET_ARCH} ?= "binutils-cross-canadian-${TRANSLATED_TARGET_ARCH}"



# Toolchain should be selected by setting TOOLCHAIN_BRAND in local.conf
# Set some sane defaults, in case someone forgets to set them in local.conf
TC_SANE_DEFAULT ?= "arm"
###TOOLCHAIN_TYPE ?= "external"
###TOOLCHAIN_BRAND ?= "${@[d.getVar('TC_SANE_DEFAULT'),'gcc'][d.getVar('TOOLCHAIN_TYPE') == 'internal']}"

###require conf/distro/include/toolchain-${TOOLCHAIN_BRAND}.inc
###require conf/distro/include/toolchain-${TOOLCHAIN_TYPE}.inc

# Enable basic stack and buffer overflow protections
#TARGET_CPPFLAGS += "-fstack-protector -D_FORTIFY_SOURCE=1"
#TARGET_CPPFLAGS += "-fstack-protector"

# Inherit "recipe-data" class to populate SRC_URI in manifest
INHERIT += "recipe-data"

# Load default preferences
###require conf/distro/include/arago-prefs.inc-------------------------------------------

# Set preferred Qt5 versions. Different namespace from Qt4, so no conflict
###include conf/distro/include/qt5-versions.inc

# Use the latest version of ltp-ddt for kernel versions 3.8+
PREFERRED_PROVIDER_ltp-ddt = "ltp-ddt"

PREFERRED_PROVIDER_virtual/gettext = "gettext"

# OpenGLES/EGL/GBM preferences
# Most of existing TI platforms have SGX GPU core
PREFERRED_PROVIDER_virtual/egl = "ti-sgx-ddk-um"
PREFERRED_PROVIDER_virtual/libgles1 = "ti-sgx-ddk-um"
PREFERRED_PROVIDER_virtual/libgles2 = "ti-sgx-ddk-um"
PREFERRED_PROVIDER_virtual/libgbm = "ti-sgx-ddk-um"
PREFERRED_PROVIDER_virtual/gpudriver = "ti-sgx-ddk-km"

PREFERRED_PROVIDER_virtual/kernel = "linux-ti-staging${ARAGO_KERNEL_SUFFIX}"

PREFERRED_PROVIDER_jpeg = "libjpeg-turbo"

# Setting PREFERRED_VERSIONS due to selecting a specific version of a library or
# application that does not have a GPLv3 license
PREFERRED_VERSION_crda = "3.18"
PREFERRED_VERSION_obex = "0.34"

PREFERRED_PROVIDER_libnl-xfrm = "libnl"

PREFERRED_PROVIDER_wpa-supplicant = "wpa-supplicant"
#PREFERRED_PROVIDER_wpa-supplicant_ti33x = "wpa-supplicant-wl18xx"
#PREFERRED_PROVIDER_wpa-supplicant_ti43x = "wpa-supplicant-wl18xx"
#PREFERRED_PROVIDER_wpa-supplicant_omap-a15 = "wpa-supplicant-wl18xx"

###--------------------------------------------------------------------------------------

# Enable generation of source packages for SDKs
require conf/distro/include/arago-source-ipk.inc

# Allow branding on top of Arago Distro and Core TI-SDK
# If ARAGO_BRAND is not set in local.conf, default to core
ARAGO_BRAND ??= "core"

###require conf/distro/include/branding-${ARAGO_BRAND}.inc

# Disable polkit's systemd configuration from meta-oe
POLKITAUTH = ""

# Disable meta-virtualization sanity check and warning
SKIP_META_VIRT_SANITY_CHECK = "1"

# Set ENTERPRISE_DISTRO flag to ensure that recipes that have been flagged
# do not attempt to enable features that have potential commercial
# licensing issues.
ENTERPRISE_DISTRO = "1"

# oe-core uses external libav instead of internal libav for gst-ffmpeg. We
# disable by default the codecs in libav that causes issues with shipping an
# Arago based SDK. No need to prevent gst-ffmpeg from being used since we
# disable troublesome software.
LICENSE_FLAGS_WHITELIST = "commercial_gst-ffmpeg commercial_gstreamer1.0-libav commercial_faad2 non-commercial_netperf"

# Do not package own copy of perl into devkit, rely on host one
###ASSUME_PROVIDED += "nativesdk-perl"

###--------------------------------------------------------------------------------------

PACKAGECONFIG_remove_pn-opkg-utils = "python"

ENABLE_BINARY_LOCALE_GENERATION = "0"
##GLIBC_GENERATE_LOCALES = "en_GB.UTF-8 tr_TR.UTF-8"
##IMAGE_LINGUAS = "en-gb tr-tr"
IMAGE_LINGUAS_remove = " en-us "


PACKAGECONFIG_remove_pn-libdrm = " \
 intel \
 radeon \
 amdgpu \
 nouveau \
 vmwgfx \
 freedreno \
 vc4 \
 etnaviv \
"

PACKAGECONFIG_remove_pn-gdb = "python"

PACKAGECONFIG_remove_pn-busybox = "hwclock"
INITSCRIPT_PACKAGES_remove_pn-busybox = "${PN}-hwclock"


DEFAULT_TIMEZONE = "Europe/Istanbul"

USE_VT = "0"

CREATE_SRCIPK_pn-linux-ti-staging = "0"
```

## conf/layer.conf
```bitbake
# We have a conf and classes directory, add to BBPATH
BBPATH .= ":${LAYERDIR}"

# We have recipes-* directories, add to BBFILES
BBFILES += "${LAYERDIR}/recipes-*/*/*.bb \
            ${LAYERDIR}/recipes-*/*/*.bbappend"

BBFILE_COLLECTIONS += "meta-motab"
BBFILE_PATTERN_meta-motab := "^${LAYERDIR}/"
BBFILE_PRIORITY_meta-motab = "16"

LAYERDEPENDS_meta-motab = "core"
LAYERSERIES_COMPAT_meta-motab = "kirkstone"
```
